## conf/distro/zinc.conf
```bitbake
require conf/distro/poky.conf

PACKAGECONFIG_pn-libanswer = "boost"

DISTRO_FEATURES_append = " mydebug"
```

## conf/layer.conf
```bitbake
# We have a conf and classes directory, add to BBPATH
BBPATH .= ":${LAYERDIR}"

# We have recipes-* directories, add to BBFILES
BBFILES += "${LAYERDIR}/recipes-*/*/*.bb \
            ${LAYERDIR}/recipes-*/*/*.bbappend"

BBFILE_COLLECTIONS += "meta-zinc"
BBFILE_PATTERN_meta-zinc = "^${LAYERDIR}/"
BBFILE_PRIORITY_meta-zinc = "6"

LAYERDEPENDS_meta-zinc = "core"
LAYERSERIES_COMPAT_meta-zinc = "dunfell"
```
